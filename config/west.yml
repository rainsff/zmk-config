## config/west.yml
```yaml
manifest:
  remotes:
    - name: zmkfirmware
      url-base: https://github.com/zmkfirmware
    - name: firstnevyn
      url-base: https://github.com/firstnevyn
  projects:
    - name: zmk
      remote: firstnevyn
      revision: main
      import: app/west.yml
  self:
    path: config
```
